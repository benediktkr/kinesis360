## config/boards/arm/adv360/Kconfig
```kconfig
# SPDX-License-Identifier: MIT

config BOARD_ENABLE_DCDC
    bool "Enable DCDC mode"
    select SOC_DCDC_NRF52X
    default y
    depends on BOARD_ADV360_LEFT || BOARD_ADV360_RIGHT

config ZMK_BATTERY_REPORTING
    bool "Enable battery reporting"
    default y
    depends on BOARD_ADV360_LEFT || BOARD_ADV360_RIGHT
```

## config/west.yml
```yaml
manifest:
  remotes:
    - name: zmkfirmware
      url-base: https://github.com/zmkfirmware
    - name: refil
      url-base: https://github.com/refil
  projects:
    - name: zmk
      remote: refil
      # The version 'z3.5' and 'z3.2' refers to the Zephyr version (not ZMK):
      # https://zmk.dev/blog/2024/02/09/zephyr-3-5
      revision: adv360-z3.2
      #revision: adv360-z3.5
      import: app/west.yml
  self:
    path: config
```
